## esp32-companion/sdkconfig.defaults
```kconfig
# ESP32-S2 Configuration
CONFIG_IDF_TARGET_ESP32S2=y
CONFIG_ESPTOOLPY_FLASHSIZE_4MB=y
CONFIG_ESPTOOLPY_FLASHFREQ_80M=y
CONFIG_ESPTOOLPY_FLASHMODE_QIO=y

# Enable USB OTG
CONFIG_TINYUSB_ENABLED=y
CONFIG_USB_ENABLED=y

# Enable Wi-Fi
CONFIG_ESP32S2_SPIRAM_SUPPORT=y
```
