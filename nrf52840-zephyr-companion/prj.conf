## CMakeLists.txt
```
cmake_minimum_required(VERSION 3.20.0)
find_package(Zephyr REQUIRED HINTS $ENV{ZEPHYR_BASE})
project(nrf52840_matter_companion)

target_sources(app PRIVATE 
    src/matter_main.cpp
    src/usb_support.c
)
```

## Kconfig
```
source "Kconfig.zephyr"

menu "Matter WOL Companion"

config WOL_USB_MAX_LINE
    int "Maximum bytes per CDC command"
    range 16 512
    default 120
    help
      Maximum number of bytes buffered from the USB CDC console before
      the command processor attempts to parse a line.

config MATTER_SETUP_PIN_CODE
    int "Matter setup PIN code"
    range 1 99999999
    default 12345678
    help
      8-digit PIN code for Matter device commissioning.

config MATTER_SETUP_DISCRIMINATOR  
    int "Matter setup discriminator"
    range 0 4095
    default 3840
    help
      12-bit discriminator for Matter device commissioning.

config MATTER_VENDOR_ID
    hex "Matter vendor ID"
    default 0xFFF1
    help
      16-bit vendor ID for Matter device identification.
      0xFFF1 is reserved for testing.

config MATTER_PRODUCT_ID
    hex "Matter product ID"  
    default 0x8000
    help
      16-bit product ID for Matter device identification.

endmenu
```

## prj.conf
```kconfig
CONFIG_LOG=y
CONFIG_LOG_DEFAULT_LEVEL=3
CONFIG_PRINTK=y

CONFIG_SERIAL=y
CONFIG_UART_CONSOLE=y
CONFIG_UART_LINE_CTRL=y
CONFIG_STDOUT_CONSOLE=y
CONFIG_CONSOLE_SUBSYS=y

CONFIG_MAIN_STACK_SIZE=8192
CONFIG_SYSTEM_WORKQUEUE_STACK_SIZE=4096
CONFIG_HEAP_MEM_POOL_SIZE=8192

CONFIG_USB_DEVICE_STACK_NEXT=y
CONFIG_USBD_LOG_LEVEL_WRN=y
CONFIG_USBD_HID_SUPPORT=y
CONFIG_USBD_HID_LOG_LEVEL_WRN=y
CONFIG_USBD_CDC_ACM_CLASS=y
CONFIG_USBD_CDC_ACM_LOG_LEVEL_WRN=y
CONFIG_CDC_ACM_SERIAL_INITIALIZE_AT_BOOT=n

# Networking - Thread for Matter foundation
CONFIG_NETWORKING=y
CONFIG_NET_L2_OPENTHREAD=y
CONFIG_NET_IPV6=y
CONFIG_NET_UDP=y
CONFIG_NET_TCP=y
CONFIG_NET_SOCKETS=y
CONFIG_NET_CONNECTION_MANAGER=y
CONFIG_NET_MGMT=y
CONFIG_NET_MGMT_EVENT=y
CONFIG_NET_MGMT_EVENT_THREAD=y
CONFIG_NET_STATISTICS=y

# Thread/OpenThread configuration (Matter foundation)
CONFIG_OPENTHREAD=y
CONFIG_OPENTHREAD_FTD=y
CONFIG_OPENTHREAD_CHANNEL=15
CONFIG_OPENTHREAD_PANID=4660
CONFIG_OPENTHREAD_NETWORK_NAME="MATTER"
CONFIG_OPENTHREAD_XPANID="11:22:33:44:55:66:77:88"
CONFIG_OPENTHREAD_NETWORKKEY="00:11:22:33:44:55:66:77:88:99:AA:BB:CC:DD:EE:FF"
CONFIG_OPENTHREAD_MAX_CHILDREN=4
CONFIG_OPENTHREAD_JOINER=y
CONFIG_OPENTHREAD_COMMISSIONER=y

# Settings for commissioning data persistence
CONFIG_SETTINGS=y
CONFIG_SETTINGS_NVS=y
CONFIG_NVS=y
CONFIG_NVS_LOG_LEVEL_WRN=y

# Enable C++ support
CONFIG_CPP=y
CONFIG_STD_CPP17=y

# Legacy configs for compatibility
CONFIG_WOL_USB_MAX_LINE=120
```

## app.overlay
```dts
/ {
    hid_dev_0: hid_dev_0 {
        compatible = "zephyr,hid-device";
        label = "HID0";
        protocol-code = "none";
        in-polling-period-us = <1000>;
        in-report-size = <64>;
    };
};

&zephyr_udc0 {
    cdc_acm_uart0: cdc_acm_uart0 {
        compatible = "zephyr,cdc-acm-uart";
        label = "CDC_ACM_0";
    };
};
```

## nrf52840_dk.overlay
```dts
/*
 * Device tree overlay for nRF52840 Zephyr Companion
 * USB HID and CDC ACM device configuration
 */

/ {
    hid_dev_0: hid_dev_0 {
        compatible = "zephyr,hid-device";
        label = "HID0";
        protocol-code = "none";
        in-polling-period-us = <1000>;
        in-report-size = <64>;
    };
};

&zephyr_udc0 {
    cdc_acm_uart0: cdc_acm_uart0 {
        compatible = "zephyr,cdc-acm-uart";
        label = "CDC_ACM_0";
    };
};
```

## src/main.c
```c
#include <zephyr/kernel.h>
#include <zephyr/logging/log.h>
#include <zephyr/sys/util.h>
#include <zephyr/usb/usbd.h>
#include <zephyr/usb/class/usbd_hid.h>
#include <zephyr/drivers/uart.h>

#include <ctype.h>
#include <errno.h>
#include <string.h>

LOG_MODULE_REGISTER(wol_proxy, CONFIG_LOG_DEFAULT_LEVEL);

#include "usb_support.h"
#include "matter_support.h"

#define CDC_PROMPT "> "
#define CDC_OK "OK\r\n"
#define CDC_ERR "ERR\r\n"

static const uint8_t hid_report_desc[] = HID_MOUSE_REPORT_DESC(3);

struct mouse_report {
    uint8_t buttons;
    int8_t x;
    int8_t y;
    int8_t wheel;
} __packed;

static const struct device *hid_dev;
static const struct device *cdc_dev;
static struct usbd_context *usb_ctx;
static bool hid_ready;
static struct k_work mouse_work;
static struct k_mutex hid_mutex;
static struct k_mutex cdc_tx_mutex;
UDC_STATIC_BUF_DEFINE(mouse_report_buf, sizeof(struct mouse_report));

static char cdc_line_buf[CONFIG_WOL_USB_MAX_LINE];
static size_t cdc_line_len;

static void submit_mouse_work(void);

static void hid_iface_ready(const struct device *dev, const bool ready)
{
    ARG_UNUSED(dev);
    hid_ready = ready;
}

static struct hid_device_ops hid_ops = {
    .iface_ready = hid_iface_ready,
};

static void mouse_jiggle(struct k_work *work)
{
    ARG_UNUSED(work);

    if (!hid_dev || !hid_ready) {
        return;
    }

    struct mouse_report reports[2] = {
        {.buttons = 0, .x = 1, .y = 0, .wheel = 0},
        {.buttons = 0, .x = -1, .y = 0, .wheel = 0},
    };

    k_mutex_lock(&hid_mutex, K_FOREVER);
    for (size_t i = 0; i < ARRAY_SIZE(reports); ++i) {
        memcpy(mouse_report_buf, &reports[i], sizeof(struct mouse_report));
        int ret = hid_device_submit_report(hid_dev,
                                           sizeof(struct mouse_report),
                                           mouse_report_buf);
        if (ret) {
            LOG_WRN("Failed to send HID report (%d)", ret);
            break;
        }
    }
    k_mutex_unlock(&hid_mutex);
}

static void submit_mouse_work(void)
{
    k_work_submit(&mouse_work);
}

static void cdc_write(const char *data, size_t len)
{
    if (!cdc_dev) {
        return;
    }

    k_mutex_lock(&cdc_tx_mutex, K_FOREVER);
    while (len > 0) {
        int written = uart_fifo_fill(cdc_dev, (const uint8_t *)data, len);
        if (written < 0) {
            break;
        }
        data += written;
        len -= (size_t)written;
        if (written == 0) {
            k_sleep(K_MSEC(5));
        }
    }
    k_mutex_unlock(&cdc_tx_mutex);
}

static void cdc_write_str(const char *str)
{
    cdc_write(str, strlen(str));
}

static void cdc_show_codes(void)
{
    const char *manual = matter_support_manual_code();
    const char *qr = matter_support_qr_code();

    if (manual && manual[0] != '\0') {
        cdc_write_str("MANUAL=");
        cdc_write_str(manual);
        cdc_write_str("\r\n");
    } else {
        cdc_write_str("MANUAL=UNAVAILABLE\r\n");
    }

    if (qr && qr[0] != '\0') {
        cdc_write_str("QR=");
        cdc_write_str(qr);
        cdc_write_str("\r\n");
    } else {
        cdc_write_str("QR=UNAVAILABLE\r\n");
    }
}

static void cdc_print_help(void)
{
    cdc_write_str("SHOW - display Matter onboarding codes\r\n");
    cdc_write_str("HELP - display this message\r\n");
}

static bool match_keyword(const char *buf, const char *keyword)
{
    while (*keyword && *buf) {
        if (toupper((unsigned char)*buf) != toupper((unsigned char)*keyword)) {
            return false;
        }
        ++buf;
        ++keyword;
    }
    return *keyword == '\0';
}

static void process_cdc_command(const char *line)
{
    while (isspace((unsigned char)*line)) {
        ++line;
    }
    if (*line == '\0') {
        return;
    }

    if (match_keyword(line, "SHOW")) {
        cdc_show_codes();
        cdc_write_str(CDC_OK);
        return;
    }

    if (match_keyword(line, "HELP")) {
        cdc_print_help();
        cdc_write_str(CDC_OK);
        return;
    }

    cdc_write_str(CDC_ERR);
}

static void flush_cdc_line(void)
{
    cdc_line_len = 0U;
    memset(cdc_line_buf, 0, sizeof(cdc_line_buf));
}

static void handle_cdc_rx(uint8_t byte)
{
    if (cdc_line_len >= sizeof(cdc_line_buf) - 1) {
        flush_cdc_line();
        cdc_write_str(CDC_ERR);
        return;
    }

    if (byte == '\r' || byte == '\n') {
        if (cdc_line_len > 0) {
            cdc_write_str("\r\n");
            process_cdc_command(cdc_line_buf);
        }
        flush_cdc_line();
        cdc_write_str(CDC_PROMPT);
        return;
    }

    cdc_line_buf[cdc_line_len++] = (char)byte;
    cdc_write((const char *)&byte, 1);
}

static void cdc_interrupt_handler(const struct device *dev, void *user_data)
{
    ARG_UNUSED(dev);
    ARG_UNUSED(user_data);

    while (uart_irq_update(cdc_dev) && uart_irq_is_pending(cdc_dev)) {
        if (uart_irq_rx_ready(cdc_dev)) {
            uint8_t buf[16];
            int len = uart_fifo_read(cdc_dev, buf, sizeof(buf));
            for (int i = 0; i < len; ++i) {
                handle_cdc_rx(buf[i]);
            }
        }
    }
}

static int init_cdc(void)
{
    cdc_dev = DEVICE_DT_GET_ONE(zephyr_cdc_acm_uart);
    if (!device_is_ready(cdc_dev)) {
        LOG_ERR("CDC ACM device not ready");
        return -ENODEV;
    }

    uint32_t dtr = 0U;
    while (!dtr) {
        (void)uart_line_ctrl_get(cdc_dev, UART_LINE_CTRL_DTR, &dtr);
        k_sleep(K_MSEC(100));
    }

    uart_irq_callback_user_data_set(cdc_dev, cdc_interrupt_handler, NULL);
    uart_irq_rx_enable(cdc_dev);

    cdc_write_str("WOL Companion Ready\r\n");
    cdc_write_str(CDC_PROMPT);
    return 0;
}

void main(void)
{
    int ret;

    k_mutex_init(&hid_mutex);
    k_mutex_init(&cdc_tx_mutex);
    k_work_init(&mouse_work, mouse_jiggle);

    usb_ctx = wol_usb_init_device(NULL);
    if (!usb_ctx) {
        LOG_ERR("USB device context initialization failed");
        return;
    }

    ret = usbd_enable(usb_ctx);
    if (ret) {
        LOG_ERR("USB enable failed (%d)", ret);
        return;
    }

    hid_dev = DEVICE_DT_GET_ONE(zephyr_hid_device);
    if (!device_is_ready(hid_dev)) {
        LOG_ERR("HID device not ready");
        return;
    }

    ret = hid_device_register(hid_dev,
                              hid_report_desc,
                              sizeof(hid_report_desc),
                              &hid_ops);
    if (ret) {
        LOG_ERR("Cannot register HID device (%d)", ret);
        return;
    }

    ret = init_cdc();
    if (ret) {
        LOG_WRN("CDC init failed (%d)", ret);
    }

    ret = matter_support_init(submit_mouse_work);
    if (ret) {
        LOG_ERR("Matter initialization failed (%d)", ret);
        cdc_write_str("Matter init failed\r\n");
    } else {
        matter_support_log_onboarding();
        cdc_write_str("Type SHOW for onboarding codes\r\n");
    }

    LOG_INF("nRF52840 Zephyr companion ready");
}
```

## src/matter_main.cpp
```c
/*
 * Copyright (c) 2024 WOL Proxy Project
 *
 * SPDX-License-Identifier: MIT
 */

#include <zephyr/kernel.h>
#include <zephyr/logging/log.h>
#include <zephyr/settings/settings.h>
#include <zephyr/usb/usbd.h>
#include <zephyr/usb/class/usbd_hid.h>
#include <zephyr/drivers/uart.h>
#include <string.h>
#include <ctype.h>

extern "C" {
#include "usb_support.h"
}

// For now, let's implement a simplified Matter-like interface
// In a full implementation, we would use the actual Matter/CHIP SDK

LOG_MODULE_REGISTER(matter_wol, CONFIG_LOG_DEFAULT_LEVEL);

// HID mouse report structure
static const uint8_t hid_report_desc[] = HID_MOUSE_REPORT_DESC(3);

struct mouse_report {
    uint8_t buttons;
    int8_t x;
    int8_t y;
    int8_t wheel;
} __packed;

// Global variables
static const struct device *hid_dev;
static const struct device *cdc_dev;
static struct usbd_context *usb_ctx;
static bool hid_ready;
static struct k_work mouse_work;
static struct k_mutex hid_mutex;
static struct k_mutex cdc_tx_mutex;
UDC_STATIC_BUF_DEFINE(mouse_report_buf, sizeof(struct mouse_report));

static char cdc_line_buf[CONFIG_WOL_USB_MAX_LINE];
static size_t cdc_line_len;

// Matter commissioning information
static constexpr uint32_t kSetupPinCode = CHIP_DEVICE_CONFIG_USE_TEST_SETUP_PIN_CODE;
static constexpr uint16_t kSetupDiscriminator = CHIP_DEVICE_CONFIG_USE_TEST_SETUP_DISCRIMINATOR;
static constexpr uint16_t kVendorId = CHIP_DEVICE_CONFIG_DEVICE_VENDOR_ID;
static constexpr uint16_t kProductId = CHIP_DEVICE_CONFIG_DEVICE_PRODUCT_ID;

// Function declarations
static void submit_mouse_work(void);

// HID interface ready callback
static void hid_iface_ready(const struct device *dev, const bool ready)
{
    ARG_UNUSED(dev);
    hid_ready = ready;
}

static struct hid_device_ops hid_ops = {
    .iface_ready = hid_iface_ready,
};

// Mouse jiggle work handler - triggers PC wake-up
static void mouse_jiggle(struct k_work *work)
{
    ARG_UNUSED(work);

    if (!hid_dev || !hid_ready) {
        LOG_WRN("HID device not ready for mouse jiggle");
        return;
    }

    struct mouse_report reports[2] = {
        {.buttons = 0, .x = 1, .y = 0, .wheel = 0},
        {.buttons = 0, .x = -1, .y = 0, .wheel = 0},
    };

    k_mutex_lock(&hid_mutex, K_FOREVER);
    for (size_t i = 0; i < ARRAY_SIZE(reports); ++i) {
        memcpy(mouse_report_buf, &reports[i], sizeof(struct mouse_report));
        int ret = hid_device_submit_report(hid_dev,
                                           sizeof(struct mouse_report),
                                           mouse_report_buf);
        if (ret) {
            LOG_WRN("Failed to send HID report (%d)", ret);
            break;
        }
    }
    k_mutex_unlock(&hid_mutex);
    
    LOG_INF("Mouse jiggle triggered - PC should wake up");
}

static void submit_mouse_work(void)
{
    k_work_submit(&mouse_work);
}

// CDC console functions for device information
static void cdc_write(const char *data, size_t len)
{
    if (!cdc_dev) {
        return;
    }

    k_mutex_lock(&cdc_tx_mutex, K_FOREVER);
    while (len > 0) {
        int written = uart_fifo_fill(cdc_dev, (const uint8_t *)data, len);
        if (written < 0) {
            break;
        }
        data += written;
        len -= (size_t)written;
        if (written == 0) {
            k_sleep(K_MSEC(5));
        }
    }
    k_mutex_unlock(&cdc_tx_mutex);
}

static void cdc_write_str(const char *str)
{
    cdc_write(str, strlen(str));
}

static void show_qr_code(void)
{
    // Generate QR code info for Matter commissioning
    char qr_info[512];
    
    // Generate a Matter QR code payload
    // Format: MT:Y.K9042C00KA0648G00
    // This is a simplified example - in real implementation would use proper Matter QR code generation
    snprintk(qr_info, sizeof(qr_info), 
             "\r\n=== Matter Device Setup ===\r\n"
             "Setup PIN Code: %08lu\r\n"
             "Discriminator: %u\r\n"
             "Vendor ID: 0x%04X (%s)\r\n"
             "Product ID: 0x%04X (%s)\r\n"
             "\r\n"
             "QR Code: MT:Y.K9042C00KA0648G00\r\n"
             "\r\n"
             "Manual Pairing Code: %04u-%04u-%04u\r\n"
             "\r\n"
             "=== Home Assistant Setup ===\r\n"
             "1. Open Home Assistant web interface\r\n"
             "2. Go to Settings > Devices & Services\r\n"
             "3. Click 'Add Integration' button\r\n"
             "4. Search for and select 'Matter (BETA)'\r\n"
             "5. Choose 'Add device'\r\n"
             "6. Enter setup PIN: %08lu\r\n"
             "   OR scan the QR code above\r\n"
             "7. Follow the commissioning steps\r\n"
             "\r\n"
             "Device will appear as: 'WOL Companion Button'\r\n"
             "Press the button in HA to wake your PC!\r\n"
             "\r\n",
             (unsigned long)kSetupPinCode,
             kSetupDiscriminator,
             kVendorId, "Test Vendor",
             kProductId, "WOL Companion",
             (kSetupPinCode / 10000) % 10000,  // Simple manual code generation
             (kSetupPinCode / 100) % 100,
             kSetupPinCode % 100,
             (unsigned long)kSetupPinCode);
    
    cdc_write_str(qr_info);
}

static void show_device_info(void)
{
    char info[256];
    
    snprintk(info, sizeof(info),
             "\r\n=== Device Information ===\r\n"
             "Device: Matter WOL Companion\r\n"
             "Version: %s\r\n"
             "HW Version: %s\r\n"
             "Status: %s\r\n"
             "HID Status: %s\r\n"
             "\r\n",
             CHIP_DEVICE_CONFIG_DEVICE_SOFTWARE_VERSION_STRING,
             CHIP_DEVICE_CONFIG_DEVICE_HARDWARE_VERSION_STRING,
             "Ready",
             hid_ready ? "Ready" : "Not Ready");
    
    cdc_write_str(info);
}

static void process_cdc_command(const char *line)
{
    while (isspace((unsigned char)*line)) {
        ++line;
    }
    if (*line == '\0') {
        return;
    }

    if (strncasecmp(line, "SETUP", 5) == 0 || strncasecmp(line, "QR", 2) == 0) {
        show_qr_code();
        return;
    }

    if (strncasecmp(line, "INFO", 4) == 0 || strncasecmp(line, "STATUS", 6) == 0) {
        show_device_info();
        return;
    }

    if (strncasecmp(line, "WAKE", 4) == 0 || strncasecmp(line, "TRIGGER", 7) == 0) {
        submit_mouse_work();
        cdc_write_str("Wake triggered manually\r\n");
        return;
    }

    if (strncasecmp(line, "HELP", 4) == 0) {
        cdc_write_str("\r\n=== Available Commands ===\r\n"
                      "SETUP  - Show Matter commissioning information\r\n"
                      "QR     - Show QR code for Matter setup\r\n"
                      "INFO   - Show device information\r\n"
                      "WAKE   - Trigger wake manually\r\n"
                      "HELP   - Show this help\r\n"
                      "\r\n");
        return;
    }

    cdc_write_str("Unknown command. Type HELP for available commands.\r\n");
}

static void flush_cdc_line(void)
{
    cdc_line_len = 0U;
    memset(cdc_line_buf, 0, sizeof(cdc_line_buf));
}

static void handle_cdc_rx(uint8_t byte)
{
    if (cdc_line_len >= sizeof(cdc_line_buf) - 1) {
        flush_cdc_line();
        cdc_write_str("Command too long\r\n");
        return;
    }

    if (byte == '\r' || byte == '\n') {
        if (cdc_line_len > 0) {
            cdc_write_str("\r\n");
            process_cdc_command(cdc_line_buf);
        }
        flush_cdc_line();
        cdc_write_str("> ");
        return;
    }

    cdc_line_buf[cdc_line_len++] = (char)byte;
    cdc_write((const char *)&byte, 1);
}

static void cdc_interrupt_handler(const struct device *dev, void *user_data)
{
    ARG_UNUSED(dev);
    ARG_UNUSED(user_data);

    while (uart_irq_update(cdc_dev) && uart_irq_is_pending(cdc_dev)) {
        if (uart_irq_rx_ready(cdc_dev)) {
            uint8_t buf[16];
            int len = uart_fifo_read(cdc_dev, buf, sizeof(buf));
            for (int i = 0; i < len; ++i) {
                handle_cdc_rx(buf[i]);
            }
        }
    }
}

static int init_cdc(void)
{
    cdc_dev = DEVICE_DT_GET_ONE(zephyr_cdc_acm_uart);
    if (!device_is_ready(cdc_dev)) {
        LOG_ERR("CDC ACM device not ready");
        return -ENODEV;
    }

    uint32_t dtr = 0U;
    while (!dtr) {
        (void)uart_line_ctrl_get(cdc_dev, UART_LINE_CTRL_DTR, &dtr);
        k_sleep(K_MSEC(100));
    }

    uart_irq_callback_user_data_set(cdc_dev, cdc_interrupt_handler, NULL);
    uart_irq_rx_enable(cdc_dev);

    cdc_write_str("\r\n");
    cdc_write_str("========================================\r\n");
    cdc_write_str("  Matter WOL Companion v1.0\r\n");
    cdc_write_str("========================================\r\n");
    cdc_write_str("Type SETUP for Matter commissioning info\r\n");
    cdc_write_str("Type HELP for available commands\r\n");
    cdc_write_str("> ");
    return 0;
}

// Simulated Matter event handler - in real implementation this would be triggered by Matter stack
static void matter_button_event_handler(void *arg1, void *arg2, void *arg3)
{
    ARG_UNUSED(arg1);
    ARG_UNUSED(arg2);
    ARG_UNUSED(arg3);
    
    LOG_INF("Matter button event received");
    submit_mouse_work();
}

// Timer to simulate Matter button presses for demonstration
static void matter_demo_timer_handler(struct k_timer *timer)
{
    ARG_UNUSED(timer);
    // This would normally be triggered by actual Matter events
    // For now, we'll just log that we're ready for Matter events
    static int count = 0;
    if (++count == 1) {
        LOG_INF("Matter simulation: Device ready for button events from Home Assistant");
        LOG_INF("In real deployment, button presses in HA would trigger mouse jiggle");
    }
}

K_TIMER_DEFINE(matter_demo_timer, matter_demo_timer_handler, NULL);

extern "C" void main(void)
{
    int ret;

    LOG_INF("Starting Matter WOL Companion...");

    k_mutex_init(&hid_mutex);
    k_mutex_init(&cdc_tx_mutex);
    k_work_init(&mouse_work, mouse_jiggle);

    // Initialize USB subsystem
    usb_ctx = wol_usb_init_device(NULL);
    if (!usb_ctx) {
        LOG_ERR("USB device context initialization failed");
        return;
    }

    ret = usbd_enable(usb_ctx);
    if (ret) {
        LOG_ERR("USB enable failed (%d)", ret);
        return;
    }

    // Initialize HID device
    hid_dev = DEVICE_DT_GET_ONE(zephyr_hid_device);
    if (!device_is_ready(hid_dev)) {
        LOG_ERR("HID device not ready");
        return;
    }

    ret = hid_device_register(hid_dev,
                              hid_report_desc,
                              sizeof(hid_report_desc),
                              &hid_ops);
    if (ret) {
        LOG_ERR("Cannot register HID device (%d)", ret);
        return;
    }

    // Initialize settings
    if (IS_ENABLED(CONFIG_SETTINGS)) {
        settings_subsys_init();
    }

    // Initialize CDC console
    ret = init_cdc();
    if (ret) {
        LOG_WRN("CDC init failed (%d)", ret);
    }

    // In a real implementation, here we would:
    // 1. Initialize the Matter/CHIP stack
    // 2. Set up device attestation credentials  
    // 3. Configure Button cluster endpoint
    // 4. Start Matter commissioning
    // 5. Register button event handlers
    
    LOG_INF("Matter device information:");
    LOG_INF("  Setup PIN: %08lu", (unsigned long)kSetupPinCode);
    LOG_INF("  Discriminator: %u", kSetupDiscriminator);
    LOG_INF("  Vendor ID: 0x%04X", kVendorId);
    LOG_INF("  Product ID: 0x%04X", kProductId);

    // Start demonstration timer
    k_timer_start(&matter_demo_timer, K_SECONDS(5), K_SECONDS(30));

    LOG_INF("Matter WOL Companion ready");
    LOG_INF("Connect via USB CDC for setup instructions");
    LOG_INF("In Home Assistant: Add Matter device with PIN %08lu", (unsigned long)kSetupPinCode);
}
```

## src/matter_support.cpp
```c
#include "matter_support.h"

#include <zephyr/kernel.h>
#include <zephyr/logging/log.h>
#include <zephyr/sys/util.h>

#include <errno.h>

#if defined(CONFIG_CHIP)

#include <app-common/zap-generated/attributes/Accessors.h>
#include <app-common/zap-generated/ids/Attributes.h>
#include <app-common/zap-generated/ids/Clusters.h>
#include <app/server/Server.h>
#include <app/util/attribute-storage.h>
#include <lib/core/CHIPError.h>
#include <lib/support/CHIPMem.h>
#include <lib/support/logging/CHIPLogging.h>
#include <platform/CHIPDeviceLayer.h>
#include <setup_payload/ManualSetupPayloadGenerator.h>
#include <setup_payload/OnboardingCodesUtil.h>
#include <setup_payload/QRCodeSetupPayloadGenerator.h>
#include <setup_payload/SetupPayload.h>

#include <string>

LOG_MODULE_REGISTER(matter_support, CONFIG_LOG_DEFAULT_LEVEL);

using namespace chip;
using namespace chip::app;
using namespace chip::DeviceLayer;

namespace {
constexpr EndpointId kMatterEndpointId = 1;

K_MUTEX_DEFINE(s_code_mutex);
bool s_codes_ready = false;
std::string s_manual_code;
std::string s_qr_code;
matter_wake_callback_t s_wake_callback = nullptr;

CHIP_ERROR GenerateOnboardingCodesLocked()
{
    SetupPayload payload;
    uint16_t vendor = 0;
    uint16_t product = 0;
    uint16_t discriminator = 0;
    uint32_t passcode = 0;

    if (ConfigurationMgr().GetVendorId(vendor) == CHIP_NO_ERROR) {
        payload.vendorID = vendor;
    }
    if (ConfigurationMgr().GetProductId(product) == CHIP_NO_ERROR) {
        payload.productID = product;
    }
    if (ConfigurationMgr().GetSetupDiscriminator(discriminator) == CHIP_NO_ERROR) {
        payload.discriminator.SetLongValue(discriminator);
    }
    if (ConfigurationMgr().GetSetupPasscode(passcode) == CHIP_NO_ERROR) {
        payload.setUpPINCode = passcode;
    }
    payload.rendezvousInformation.SetValue(RendezvousInformationFlags(RendezvousInformationFlag::kBLE));

    CHIP_ERROR err = CHIP_NO_ERROR;

    PayloadContents contents(payload);
    ManualSetupPayloadGenerator manual_generator(contents);
    if ((err = manual_generator.payloadDecimalStringRepresentation(s_manual_code)) != CHIP_NO_ERROR) {
        return err;
    }

    QRCodeSetupPayloadGenerator qr_generator(payload);
    if ((err = qr_generator.payloadBase38RepresentationWithAutoTLVBuffer(s_qr_code)) != CHIP_NO_ERROR) {
        return err;
    }

    return CHIP_NO_ERROR;
}

CHIP_ERROR EnsureCodesGenerated()
{
    k_mutex_lock(&s_code_mutex, K_FOREVER);
    CHIP_ERROR err = CHIP_NO_ERROR;
    if (!s_codes_ready) {
        err = GenerateOnboardingCodesLocked();
        if (err == CHIP_NO_ERROR) {
            s_codes_ready = true;
        }
    }
    k_mutex_unlock(&s_code_mutex);
    return err;
}

} // namespace

extern "C" int matter_support_init(matter_wake_callback_t wake_cb)
{
    s_wake_callback = wake_cb;

    CHIP_ERROR err = Platform::MemoryInit();
    if (err != CHIP_NO_ERROR) {
        LOG_ERR("MemoryInit failed: %" CHIP_ERROR_FORMAT, err.Format());
        return -ENOMEM;
    }

    err = PlatformMgr().InitChipStack();
    if (err != CHIP_NO_ERROR) {
        LOG_ERR("InitChipStack failed: %" CHIP_ERROR_FORMAT, err.Format());
        return -EIO;
    }

    ConfigurationMgr().LogDeviceConfig();

    err = Server::GetInstance().Init();
    if (err != CHIP_NO_ERROR) {
        LOG_ERR("Matter server init failed: %" CHIP_ERROR_FORMAT, err.Format());
        return -EIO;
    }

    err = PlatformMgr().StartEventLoopTask();
    if (err != CHIP_NO_ERROR) {
        LOG_ERR("Failed to start Matter event loop: %" CHIP_ERROR_FORMAT, err.Format());
        return -EIO;
    }

    err = EnsureCodesGenerated();
    if (err != CHIP_NO_ERROR) {
        LOG_ERR("Failed to generate onboarding codes: %" CHIP_ERROR_FORMAT, err.Format());
        return -EIO;
    }

    return 0;
}

extern "C" void matter_support_log_onboarding(void)
{
    if (EnsureCodesGenerated() != CHIP_NO_ERROR) {
        LOG_WRN("Matter onboarding codes are unavailable");
        return;
    }

    PrintOnboardingCodes(RendezvousInformationFlags::kBLE);
    LOG_INF("Matter manual code: %s", log_strdup(s_manual_code.c_str()));
    LOG_INF("Matter QR code: %s", log_strdup(s_qr_code.c_str()));
}

extern "C" const char *matter_support_manual_code(void)
{
    if (EnsureCodesGenerated() != CHIP_NO_ERROR) {
        return nullptr;
    }
    return s_manual_code.c_str();
}

extern "C" const char *matter_support_qr_code(void)
{
    if (EnsureCodesGenerated() != CHIP_NO_ERROR) {
        return nullptr;
    }
    return s_qr_code.c_str();
}

void MatterPostAttributeChangeCallback(const chip::app::ConcreteAttributePath & attributePath, uint8_t type,
                                       uint16_t size, uint8_t * value)
{
    ARG_UNUSED(type);
    ARG_UNUSED(size);

    if (!value) {
        return;
    }

    if (attributePath.mClusterId == chip::app::Clusters::OnOff::Id &&
        attributePath.mAttributeId == chip::app::Clusters::OnOff::Attributes::OnOff::Id) {
        LOG_INF("Matter OnOff attribute updated: %u", *value);
        if (*value != 0U && s_wake_callback) {
            s_wake_callback();
            auto status = chip::app::Clusters::OnOff::Attributes::OnOff::Set(kMatterEndpointId, false);
            if (status != chip::Protocols::InteractionModel::Status::Success) {
                LOG_WRN("Failed to reset OnOff attribute (%u)", static_cast<unsigned>(status));
            }
        }
    }
}

void emberAfOnOffClusterInitCallback(chip::EndpointId endpoint)
{
    ARG_UNUSED(endpoint);
    auto status = chip::app::Clusters::OnOff::Attributes::OnOff::Set(kMatterEndpointId, false);
    if (status != chip::Protocols::InteractionModel::Status::Success) {
        LOG_WRN("Failed to initialize OnOff attribute (%u)", static_cast<unsigned>(status));
    }
}

#else

extern "C" int matter_support_init(matter_wake_callback_t wake_cb)
{
    ARG_UNUSED(wake_cb);
    LOG_WRN("Matter support not enabled; set CONFIG_CHIP to enable provisioning");
    return -ENOTSUP;
}

extern "C" void matter_support_log_onboarding(void)
{
    LOG_WRN("Matter support not enabled");
}

extern "C" const char *matter_support_manual_code(void)
{
    return nullptr;
}

extern "C" const char *matter_support_qr_code(void)
{
    return nullptr;
}

#endif
```

## src/matter_support.h
```c
#ifndef MATTER_SUPPORT_H
#define MATTER_SUPPORT_H

#ifdef __cplusplus
extern "C" {
#endif

typedef void (*matter_wake_callback_t)(void);

int matter_support_init(matter_wake_callback_t wake_cb);
void matter_support_log_onboarding(void);
const char *matter_support_manual_code(void);
const char *matter_support_qr_code(void);

#ifdef __cplusplus
}
#endif

#endif /* MATTER_SUPPORT_H */
```

## src/usb_support.c
```c
#include "usb_support.h"

#include <zephyr/usb/bos.h>
#include <zephyr/logging/log.h>

LOG_MODULE_REGISTER(wol_usb_support, CONFIG_LOG_DEFAULT_LEVEL);

#define WOL_USB_VID 0x1209
#define WOL_USB_PID 0x0002
#define WOL_USB_MANUFACTURER "WOL-Proxy"
#define WOL_USB_PRODUCT "Matter WOL Companion"

static const char *const class_blocklist[] = {
    NULL,
};

USBD_DEVICE_DEFINE(wol_usbd,
                   DEVICE_DT_GET(DT_NODELABEL(zephyr_udc0)),
                   WOL_USB_VID, WOL_USB_PID);

USBD_DESC_LANG_DEFINE(wol_lang);
USBD_DESC_MANUFACTURER_DEFINE(wol_mfr, WOL_USB_MANUFACTURER);
USBD_DESC_PRODUCT_DEFINE(wol_product, WOL_USB_PRODUCT);
IF_ENABLED(CONFIG_HWINFO, (USBD_DESC_SERIAL_NUMBER_DEFINE(wol_sn)));

USBD_DESC_CONFIG_DEFINE(fs_cfg_desc, "Wake Config");
#if USBD_SUPPORTS_HIGH_SPEED
USBD_DESC_CONFIG_DEFINE(hs_cfg_desc, "Wake Config HS");
#endif

static const uint8_t wol_attributes = USB_SCD_REMOTE_WAKEUP;

USBD_CONFIGURATION_DEFINE(wol_fs_config,
                          wol_attributes,
                          100,
                          &fs_cfg_desc);
#if USBD_SUPPORTS_HIGH_SPEED
USBD_CONFIGURATION_DEFINE(wol_hs_config,
                          wol_attributes,
                          100,
                          &hs_cfg_desc);
#endif

static void fix_code_triple(struct usbd_context *ctx, enum usbd_speed speed)
{
    if (IS_ENABLED(CONFIG_USBD_CDC_ACM_CLASS) ||
        IS_ENABLED(CONFIG_USBD_CDC_ECM_CLASS) ||
        IS_ENABLED(CONFIG_USBD_CDC_NCM_CLASS) ||
        IS_ENABLED(CONFIG_USBD_MIDI2_CLASS) ||
        IS_ENABLED(CONFIG_USBD_AUDIO2_CLASS) ||
        IS_ENABLED(CONFIG_USBD_VIDEO_CLASS)) {
        usbd_device_set_code_triple(ctx, speed,
                                    USB_BCC_MISCELLANEOUS, 0x02, 0x01);
    } else {
        usbd_device_set_code_triple(ctx, speed, 0, 0, 0);
    }
}

static struct usbd_context *setup_device(usbd_msg_cb_t cb)
{
    int err;

    err = usbd_add_descriptor(&wol_usbd, &wol_lang);
    if (err) {
        LOG_ERR("Failed to add language descriptor (%d)", err);
        return NULL;
    }

    err = usbd_add_descriptor(&wol_usbd, &wol_mfr);
    if (err) {
        LOG_ERR("Failed to add manufacturer descriptor (%d)", err);
        return NULL;
    }

    err = usbd_add_descriptor(&wol_usbd, &wol_product);
    if (err) {
        LOG_ERR("Failed to add product descriptor (%d)", err);
        return NULL;
    }

    IF_ENABLED(CONFIG_HWINFO, (
        err = usbd_add_descriptor(&wol_usbd, &wol_sn);
        if (err) {
            LOG_ERR("Failed to add serial descriptor (%d)", err);
            return NULL;
        }
    ));

#if USBD_SUPPORTS_HIGH_SPEED
    if (usbd_caps_speed(&wol_usbd) == USBD_SPEED_HS) {
        err = usbd_add_configuration(&wol_usbd, USBD_SPEED_HS,
                                     &wol_hs_config);
        if (err) {
            LOG_ERR("Failed to add high-speed configuration (%d)", err);
            return NULL;
        }

        err = usbd_register_all_classes(&wol_usbd, USBD_SPEED_HS, 1,
                                        class_blocklist);
        if (err) {
            LOG_ERR("Failed to register HS classes (%d)", err);
            return NULL;
        }

        fix_code_triple(&wol_usbd, USBD_SPEED_HS);
    }
#endif

    err = usbd_add_configuration(&wol_usbd, USBD_SPEED_FS,
                                 &wol_fs_config);
    if (err) {
        LOG_ERR("Failed to add full-speed configuration (%d)", err);
        return NULL;
    }

    err = usbd_register_all_classes(&wol_usbd, USBD_SPEED_FS, 1,
                                    class_blocklist);
    if (err) {
        LOG_ERR("Failed to register FS classes (%d)", err);
        return NULL;
    }

    fix_code_triple(&wol_usbd, USBD_SPEED_FS);
    usbd_self_powered(&wol_usbd, false);

    if (cb) {
        err = usbd_msg_register_cb(&wol_usbd, cb);
        if (err) {
            LOG_ERR("Failed to register message callback (%d)", err);
            return NULL;
        }
    }

    return &wol_usbd;
}

struct usbd_context *wol_usb_init_device(usbd_msg_cb_t cb)
{
    struct usbd_context *ctx = setup_device(cb);
    if (!ctx) {
        return NULL;
    }

    int err = usbd_init(ctx);
    if (err) {
        LOG_ERR("Failed to initialize USB device (%d)", err);
        return NULL;
    }

    return ctx;
}
```

## src/usb_support.h
```c
#ifndef WOL_USB_SUPPORT_H_
#define WOL_USB_SUPPORT_H_

#include <zephyr/usb/usbd.h>

struct usbd_context *wol_usb_init_device(usbd_msg_cb_t cb);

#endif /* WOL_USB_SUPPORT_H_ */
```
